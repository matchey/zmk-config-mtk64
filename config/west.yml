## config/west.yml
```yaml
manifest:
  remotes:
    - name: zmkfirmware
      url-base: https://github.com/zmkfirmware
    - name: mentako-ya
      url-base: https://github.com/mentako-ya
    - name: badjeff
      url-base: https://github.com/badjeff
    - name: caksoylar
      url-base: https://github.com/caksoylar
    - name: englmaxi
      url-base: https://github.com/englmaxi
    # - name: carrefinho
    #   url-base: https://github.com/carrefinho
    # - name: janpfischer
    #   url-base: https://github.com/janpfischer
    - name: prospector
      url-base: https://github.com/t-ogura
    - name: matchey
      url-base: https://github.com/matchey
  projects:
    - name: zmk
      remote: zmkfirmware
      revision: main
      import: app/west.yml
    - name: zmk-pmw3610-driver
      remote: badjeff
      revision: main
    - name: zmk-rgbled-widget
      remote: caksoylar
      revision: main
    - name: zmk-dongle-display
      remote: englmaxi
      revision: main
    # - name: prospector-zmk-module
    #   remote: carrefinho
    #   revision: core/zephyr-4-1 # xiao_ble instead of seeeduino_xiao_ble
    # - name: zmk-dongle-screen
    #   remote: janpfischer
    #   revision: main
    - name: prospector-zmk-module
      remote: prospector
      revision: v2.1.0  # Use v2.0.0 for ZMK ≤0.3 (Zephyr 3.x)
      path: modules/prospector-zmk-module
    - name: zmk-input-processor-axis-constrain
      remote: matchey
      revision: v0.2.0
  self:
    path: config
```
