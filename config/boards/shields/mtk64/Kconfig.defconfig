## config/boards/shields/mtk64/Kconfig.defconfig
```kconfig
if SHIELD_MTK64_R

config ZMK_KEYBOARD_NAME
    default "mtk64_R"

config ZMK_SPLIT
    default y

endif # SHIELD_MTK64_R

if SHIELD_MTK64_L

config ZMK_KEYBOARD_NAME
    default "mtk64_L"

config ZMK_SPLIT
    default y

endif # SHIELD_MTK64_L

if SHIELD_MTK64_FOOT

config ZMK_KEYBOARD_NAME
    default "mtk64_FOOT"

config ZMK_SPLIT
    default y

endif # SHIELD_MTK64_FOOT

if SHIELD_MTK64_DONGLE

config ZMK_KEYBOARD_NAME
    default "mtk64"

config ZMK_SPLIT
    default y

config ZMK_SPLIT_ROLE_CENTRAL
    default y

# Set this to the number of peripherals your dongle will have.
# For a unibody, this would be 1. If you have left and right halves, set it to 2, etc.
config ZMK_SPLIT_BLE_CENTRAL_PERIPHERALS
    default 3

# Set this to ZMK_SPLIT_BLE_CENTRAL_PERIPHERALS + your desired number of BT profiles (default is 5)
config BT_MAX_CONN
    default 8

# Set this to the same number as BT_MAX_CONN
config BT_MAX_PAIRED
    default 8


if ZMK_DISPLAY

config I2C
    default y

config SSD1306
    default y

choice ZMK_DISPLAY_WORK_QUEUE
    default ZMK_DISPLAY_WORK_QUEUE_DEDICATED
endchoice

if LVGL

config LV_Z_VDB_SIZE
    default 64

config LV_DPI_DEF
    default 148

config LV_Z_BITS_PER_PIXEL
    default 1

choice LV_COLOR_DEPTH
    default LV_COLOR_DEPTH_1
endchoice

endif # LVGL

endif # ZMK_DISPLAY

endif # SHIELD_MTK64_DONGLE
```
